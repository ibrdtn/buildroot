## configs/buffalo_lsgl_defconfig
```kconfig
# Buffalo Link Station GL
#

# architecture
BR2_arm=y
BR2_arm926t=y
BR2_ARM_EABI=y
BR2_ARM_SOFT_FLOAT=y

# kernel
BR2_KERNEL_HEADERS_3_0=y
BR2_DEFAULT_KERNEL_HEADERS="3.0.101"

# toolchain
BR2_TOOLCHAIN_BUILDROOT_LARGEFILE=y
BR2_TOOLCHAIN_BUILDROOT_INET_IPV6=y
BR2_TOOLCHAIN_BUILDROOT_CXX=y
BR2_PTHREADS_OLD=y

# packages
BR2_PREFER_STATIC_LIB=y
BR2_PACKAGE_IBRDTND=y
BR2_PACKAGE_IBRDTN_TOOLS=y
```

## configs/ibrdtn_arm_defconfig
```kconfig
# Architecture
BR2_arm=y

# uClibc features
BR2_INSTALL_LIBSTDCPP=y
BR2_TOOLCHAIN_BUILDROOT_LARGEFILE=y
BR2_TOOLCHAIN_BUILDROOT_INET_IPV6=y
BR2_TOOLCHAIN_BUILDROOT_INET_RPC=y
BR2_TOOLCHAIN_BUILDROOT_WCHAR=y
BR2_TOOLCHAIN_BUILDROOT_LOCALE=y
BR2_TOOLCHAIN_BUILDROOT_CXX=y
BR2_TOOLCHAIN_BUILDROOT_USE_SSP=y
BR2_PREFER_STATIC_LIB=y

# packages
BR2_PACKAGE_IBRDTND=y
BR2_PACKAGE_IBRDTN_TOOLS=y

# filesystem
BR2_TARGET_ROOTFS_TAR=y
```

## configs/ibrdtn_x86_defconfig
```kconfig
# Architecture
BR2_i386=y

# uClibc features
BR2_TOOLCHAIN_BUILDROOT_LARGEFILE=y
BR2_TOOLCHAIN_BUILDROOT_INET_IPV6=y
BR2_TOOLCHAIN_BUILDROOT_CXX=y
BR2_PREFER_STATIC_LIB=y
BR2_PTHREADS_OLD=y

# packages
BR2_PACKAGE_IBRDTND=y
BR2_PACKAGE_IBRDTN_TOOLS=y

# filesystem
BR2_TARGET_ROOTFS_TAR=y
```

## configs/ka_wifisd_defconfig
```kconfig
# Transcend WIFI-SD
#

# architecture
BR2_arm=y
BR2_arm926t=y
BR2_ARM_EABI=y
BR2_ARM_SOFT_FLOAT=y

# kernel
BR2_KERNEL_HEADERS_VERSION=y
BR2_DEFAULT_KERNEL_VERSION="2.6.32.28"
BR2_DEFAULT_KERNEL_HEADERS="2.6.32.28"
BR2_LINUX_KERNEL_CUSTOM_TARBALL=y
BR2_LINUX_KERNEL_CUSTOM_TARBALL_LOCATION="https://www.kernel.org/pub/linux/kernel/v2.6/longterm/v2.6.32/linux-2.6.32.28.tar.xz"

# toolchain
BR2_TOOLCHAIN_BUILDROOT_LARGEFILE=y
BR2_TOOLCHAIN_BUILDROOT_INET_IPV6=y
BR2_TOOLCHAIN_BUILDROOT_CXX=y

# packages
BR2_PREFER_STATIC_LIB=y
BR2_PACKAGE_IBRDTND=y
BR2_PACKAGE_IBRDTN_TOOLS=y
```
